// GENERATED by tools/build_wokwi.py from firmware/VibeGuard/. Edit the firmware, not this file.
#define VG_SIM 1
// VibeGuard: motor fault diagnosis on an ESP32 + MPU6050.
//
// Samples Z-axis acceleration at 500 Hz, runs a 256-point Hann-windowed FFT every 0.512 s, compares
// three fault bands with a baseline learned in the first 20 s, and serves a dashboard from its own
// WiFi access point at http://192.168.4.1/ .
//
// Build: Arduino IDE / arduino-cli with the "esp32" core (2.x or 3.x), board "ESP32 Dev Module".
// No external libraries. Set VG_SIM to 1 for the Wokwi simulation (synthetic vibration is added to
// the sensor reading, WiFi joins Wokwi-GUEST instead of starting an AP).
#ifndef VG_SIM
#define VG_SIM 0
#endif

#include <Arduino.h>
#include <WebServer.h>
#include <WiFi.h>
#include <Wire.h>
#include "esp_timer.h"

// ===== vg_config.h =====
// VibeGuard configuration: every tunable number lives here.
// Shared by the ESP32 firmware and the host test harness (no Arduino dependencies).
#include <stdint.h>

namespace vg {

// ---- Sampling and FFT ------------------------------------------------------
constexpr float FS_HZ = 500.0f;                 // MPU6050 Z-axis sample rate
constexpr int   N_FFT = 256;                    // samples per frame (must be a power of two)
constexpr int   N_BINS = N_FFT / 2;             // usable bins 0..127 (Nyquist bin dropped)
constexpr float BIN_HZ = FS_HZ / N_FFT;         // 1.953 Hz per bin
constexpr float FRAME_SECONDS = N_FFT / FS_HZ;  // 0.512 s per frame
constexpr float kPi = 3.14159265358979f;

// ---- MPU6050 ---------------------------------------------------------------
constexpr float LSB_PER_G = 8192.0f;            // +-4 g full scale (ACCEL_CONFIG = 0x08)

// ---- Baseline learning -----------------------------------------------------
constexpr float CALIB_SECONDS = 20.0f;
constexpr int   CALIB_FRAMES = int(CALIB_SECONDS / FRAME_SECONDS + 0.5f);  // 39 frames = 19.97 s

// ---- Shaft (1x) frequency search ------------------------------------------
constexpr float SHAFT_MIN_HZ = 8.0f;            // 480 RPM
constexpr float SHAFT_MAX_HZ = 80.0f;           // 4800 RPM
constexpr float SHAFT_TRACK_TOL = 0.10f;        // re-track 1x within +-10% of the learned value
constexpr float PEAK_PROMINENCE = 4.0f;         // peak must be 4x the mean power of the search range

// ---- Fault bands -----------------------------------------------------------
constexpr int   HARMONIC_HALF_WIDTH = 2;        // bins either side of 1x/2x/3x (Hann main lobe)
constexpr float BEARING_LO_HZ = 100.0f;
constexpr float BEARING_HI_HZ = 240.0f;         // stays below the 250 Hz Nyquist limit
constexpr int   BEARING_EXCLUDE_HARMONICS = 8;  // 1x..8x lines are removed from the bearing band
constexpr int   BEARING_EXCLUDE_HALF_WIDTH = 1;

// ---- Decision logic --------------------------------------------------------
// Ratios are band energy / learned baseline energy (energy ratio 4 = amplitude x2 = +6 dB).
constexpr float WARN_RATIO = 3.0f;              // minimum warning threshold (+4.8 dB)
constexpr float ALARM_RATIO = 6.0f;             // minimum alarm threshold   (+7.8 dB)
constexpr float THRESH_K_SIGMA = 4.0f;          // warn >= 1 + k * (baseline std / mean)
constexpr float HEALTH_ZERO_RATIO = 16.0f;      // ratio at which health reaches 0 % (+12 dB)
constexpr float EMA_ALPHA = 0.3f;               // smoothing of the per-frame ratios
constexpr int   PERSIST_FRAMES = 3;             // frames above threshold before a fault is declared
constexpr float CLEAR_HYSTERESIS = 0.8f;        // a declared fault clears only below 0.8 x warning
constexpr float ALARM_HYSTERESIS = 0.85f;       // an alarm drops to warning only below 0.85 x alarm
constexpr float MOTOR_OFF_RMS_G = 0.010f;       // below this the motor is treated as stopped
constexpr float ENERGY_FLOOR = 1e-9f;           // avoids dividing by an empty band

// ---- Advisory costs (INR) --------------------------------------------------
// Bearing and motor figures come from the project pitch; the others are estimates, edit to suit.
constexpr int COST_MOTOR_REPLACEMENT = 1800;
constexpr int COST_BEARING_FIX = 150;
constexpr int COST_REBALANCE = 100;
constexpr int COST_TIGHTEN = 50;

}  // namespace vg
// ===== vg_dashboard.h =====
// Dashboard page served at http://192.168.4.1/ . Self-contained (no CDN): the AP has no internet.
// tools/dashboard_mock.py extracts this same string, so the mock and the device serve identical HTML.
#ifndef PROGMEM
#define PROGMEM
#endif

static const char DASHBOARD_HTML[] PROGMEM = R"VGHTML(<!doctype html>
<html lang="en"><head><meta charset="utf-8"><meta name="viewport" content="width=device-width,initial-scale=1">
<title>VibeGuard</title>
<style>
:root{--bg:#f4f5f7;--card:#fff;--ink:#16191d;--mute:#667080;--line:#e2e5ea;--ok:#1f9d6b;--warn:#d98a00;--bad:#d64545;--off:#7a828e;--accent:#2b6cb0;--band:#e8eef7}
@media (prefers-color-scheme:dark){:root{--bg:#111418;--card:#1a1e24;--ink:#e8ebef;--mute:#98a1ad;--line:#2a3038;--band:#1f2a38;--accent:#6aa5e8}}
*{box-sizing:border-box}body{margin:0;background:var(--bg);color:var(--ink);font:15px/1.4 system-ui,-apple-system,Segoe UI,Roboto,sans-serif}
header{display:flex;align-items:center;gap:10px;padding:14px 16px;border-bottom:1px solid var(--line);background:var(--card)}
header h1{font-size:18px;margin:0;letter-spacing:.2px}header .sub{color:var(--mute);font-size:13px}
#conn{margin-left:auto;font-size:12px;color:var(--mute)}#conn i{display:inline-block;width:8px;height:8px;border-radius:50%;background:var(--off);margin-right:6px}
main{max-width:980px;margin:0 auto;padding:16px;display:grid;gap:14px;grid-template-columns:repeat(12,1fr)}
.card{background:var(--card);border:1px solid var(--line);border-radius:12px;padding:14px 16px;grid-column:span 12}
@media(min-width:760px){.s4{grid-column:span 4}.s8{grid-column:span 8}.s6{grid-column:span 6}}
h2{font-size:12px;text-transform:uppercase;letter-spacing:.08em;color:var(--mute);margin:0 0 10px}
.hero{display:flex;gap:18px;align-items:center}.ring{position:relative;width:120px;height:120px;flex:none}
.ring svg{transform:rotate(-90deg)}.ring b{position:absolute;inset:0;display:grid;place-items:center;font-size:28px}
.badge{display:inline-block;padding:3px 10px;border-radius:999px;font-weight:600;font-size:13px;color:#fff;background:var(--off)}
.fault{font-size:20px;font-weight:600;margin:8px 0 4px}.mute{color:var(--mute);font-size:13px}
.kv{display:grid;grid-template-columns:1fr 1fr;gap:10px}.kv div{border:1px solid var(--line);border-radius:10px;padding:8px 10px}
.kv b{display:block;font-size:20px}.kv span{font-size:12px;color:var(--mute)}
.bar{margin:10px 0}.bar .lbl{display:flex;justify-content:space-between;font-size:13px}
.track{position:relative;height:12px;background:var(--band);border-radius:6px;overflow:hidden;margin-top:4px}
.fill{position:absolute;left:0;top:0;bottom:0;background:var(--ok);border-radius:6px;transition:width .4s}
.tick{position:absolute;top:-2px;bottom:-2px;width:2px}
canvas{width:100%;height:220px;display:block}
.adv{border-left:4px solid var(--off);padding-left:12px}.money{display:flex;gap:16px;flex-wrap:wrap;margin-top:8px;font-size:14px}
button{font:inherit;border:1px solid var(--line);background:var(--card);color:var(--ink);border-radius:8px;padding:7px 12px;cursor:pointer}
button:hover{border-color:var(--accent)}button.on{background:var(--accent);color:#fff;border-color:var(--accent)}
.row{display:flex;gap:8px;flex-wrap:wrap;align-items:center}#sim{display:none}
.prog{height:8px;background:var(--band);border-radius:4px;overflow:hidden;margin-top:8px}.prog i{display:block;height:100%;background:var(--accent);width:0}
</style></head><body>
<header><h1>VibeGuard</h1><span class="sub">Motor vibration monitor</span><span id="conn"><i></i>connecting</span></header>
<main>
<section class="card s8"><h2>Machine health</h2><div class="hero">
<div class="ring"><svg width="120" height="120"><circle cx="60" cy="60" r="52" stroke="var(--band)" stroke-width="12" fill="none"/>
<circle id="arc" cx="60" cy="60" r="52" stroke="var(--ok)" stroke-width="12" fill="none" stroke-linecap="round" stroke-dasharray="0 999"/></svg><b id="health">--</b></div>
<div><span class="badge" id="state">--</span><div class="fault" id="fault">--</div><div class="mute" id="why">Waiting for data</div>
<div id="calbox" style="display:none"><div class="mute" id="caltxt"></div><div class="prog"><i id="calbar"></i></div></div></div></div></section>
<section class="card s4"><h2>Live readings</h2><div class="kv">
<div><b id="rpm">--</b><span>Shaft RPM</span></div><div><b id="f1">--</b><span>1x frequency (Hz)</span></div>
<div><b id="rms">--</b><span>Vibration RMS (mg)</span></div><div><b id="proc">--</b><span>DSP time (us)</span></div></div></section>
<section class="card s6"><h2>Fault bands (energy vs. learned baseline)</h2><div id="bars"></div>
<div class="mute">Orange tick = warning threshold, red tick = alarm threshold (learned per motor).</div></section>
<section class="card s6"><h2>Advice</h2><div class="adv" id="advbox"><div id="action">--</div>
<div class="money"><span>Repair now: <b id="repair">--</b></span><span>If it fails: <b id="failure">--</b></span><span>Saving: <b id="saving">--</b></span></div></div>
<div class="row" style="margin-top:14px"><button id="recal">Re-learn baseline (20 s)</button></div></section>
<section class="card"><h2>Spectrum (last 0.512 s frame)</h2><canvas id="spec"></canvas>
<div class="mute">Shaded: 1x, 2x and 3x lines and the 100-240 Hz bearing band. Resolution 1.95 Hz per bin.</div></section>
<section class="card" id="sim"><h2>Simulation controls</h2><div class="row" id="scen"></div>
<div class="row" style="margin-top:10px"><label class="mute">Severity <input id="sev" type="range" min="0" max="2" step="0.05" value="1"></label><b id="sevv">1.00</b></div></section>
</main>
<script>
const $=id=>document.getElementById(id),C={HEALTHY:'--ok',WARNING:'--warn',ALARM:'--bad',MOTOR_OFF:'--off',CALIBRATING:'--accent'};
const col=v=>getComputedStyle(document.documentElement).getPropertyValue(v).trim();
const NAMES=['Rotor imbalance (1x)','Looseness (2x-3x)','Bearing wear (100-240 Hz)'];
const FN={NONE:'No fault detected',IMBALANCE:'Rotor imbalance',LOOSENESS:'Mechanical looseness',BEARING:'Bearing wear'};
const inr=v=>'₹'+Number(v).toLocaleString('en-IN');
let last=null,spec=null,simBuilt=false;
function lg(r){return Math.max(0,Math.min(1,Math.log(Math.max(r,1))/Math.log(16)))}
function render(s){
 const c=col(C[s.state]||'--off');$('state').textContent=s.state.replace('_',' ');$('state').style.background=c;
 $('health').textContent=s.state=='CALIBRATING'?'--':Math.round(s.health)+'%';
 const L=2*Math.PI*52,h=s.state=='CALIBRATING'?0:s.health/100;$('arc').setAttribute('stroke-dasharray',(L*h)+' 999');$('arc').setAttribute('stroke',c);
 $('fault').textContent=s.state=='CALIBRATING'?'Learning healthy baseline':s.state=='MOTOR_OFF'?'Motor stopped':FN[s.fault];
 const cb=s.state=='CALIBRATING';$('calbox').style.display=cb?'block':'none';
 if(cb){$('caltxt').textContent=`Frame ${s.calib.done} of ${s.calib.total}. Keep the motor running and healthy.`;$('calbar').style.width=(100*s.calib.done/s.calib.total)+'%'}
 let w=0;for(let i=1;i<3;i++)if(s.ratio[i]/s.warn[i]>s.ratio[w]/s.warn[w])w=i;
 $('why').textContent=cb?'':s.state=='MOTOR_OFF'?'Vibration below the running threshold':`Highest band: ${NAMES[w]} at x${s.ratio[w].toFixed(2)} of baseline`;
 $('rpm').textContent=s.rpm||'--';$('f1').textContent=s.f1?s.f1.toFixed(1):'--';$('rms').textContent=s.rmsMg.toFixed(1);$('proc').textContent=s.rt.procUs;
 let html='';for(let i=0;i<3;i++){const r=s.ratio[i],bc=r>=s.alarm[i]?'--bad':r>=s.warn[i]?'--warn':'--ok';
  html+=`<div class="bar"><div class="lbl"><span>${NAMES[i]}</span><b>x${r.toFixed(2)}</b></div><div class="track">
  <div class="fill" style="width:${100*lg(r)}%;background:${col(bc)}"></div>
  <div class="tick" style="left:${100*lg(s.warn[i])}%;background:${col('--warn')}"></div><div class="tick" style="left:${100*lg(s.alarm[i])}%;background:${col('--bad')}"></div></div></div>`}
 $('bars').innerHTML=html;
 $('action').textContent=s.advice.action;$('advbox').style.borderColor=c;
 const f=s.advice.failure>0;$('repair').textContent=f?inr(s.advice.repair):'-';$('failure').textContent=f?inr(s.advice.failure):'-';$('saving').textContent=f?inr(s.advice.saving):'-';
 if(s.sim){$('sim').style.display='block';if(!simBuilt){simBuilt=true;$('scen').innerHTML=['healthy','imbalance','looseness','bearing','motor_off'].map(n=>`<button data-s="${n}">${n.replace('_',' ')}</button>`).join('');
  $('scen').onclick=e=>{const n=e.target.dataset.s;if(n)post('/api/sim?scenario='+n+'&severity='+$('sev').value)}}
  document.querySelectorAll('#scen button').forEach(b=>b.classList.toggle('on',b.dataset.s==s.scenario))}
}
function drawSpec(){const cv=$('spec'),d=window.devicePixelRatio||1,W=cv.clientWidth,H=cv.clientHeight;cv.width=W*d;cv.height=H*d;
 const g=cv.getContext('2d');g.scale(d,d);g.clearRect(0,0,W,H);if(!spec)return;
 const p={l:40,r:8,t:8,b:22},w=W-p.l-p.r,h=H-p.t-p.b,mx=Math.max(5,...spec.mg.slice(2))*1.1,n=spec.mg.length,fmax=n*spec.binHz;
 const X=f=>p.l+w*f/fmax,Y=v=>p.t+h*(1-v/mx);g.fillStyle=col('--band');
 g.fillRect(X(spec.bearing[0]),p.t,X(spec.bearing[1])-X(spec.bearing[0]),h);
 if(spec.f1>0)for(let k=1;k<=3;k++){g.fillStyle=col(k==1?'--ok':'--warn')+'33';g.fillRect(X(k*spec.f1-2.5*spec.binHz),p.t,X(5*spec.binHz)-X(0),h)}
 g.strokeStyle=col('--line');g.fillStyle=col('--mute');g.font='11px system-ui';g.lineWidth=1;
 for(let f=0;f<=250;f+=50){g.beginPath();g.moveTo(X(f),p.t);g.lineTo(X(f),p.t+h);g.stroke();g.fillText(f+' Hz',X(f)-12,H-6)}
 for(let i=0;i<=4;i++){const v=mx*i/4;g.fillText(v.toFixed(v<10?1:0),4,Y(v)+4)}
 g.strokeStyle=col('--accent');g.lineWidth=1.5;g.beginPath();spec.mg.forEach((v,k)=>{k?g.lineTo(X(k*spec.binHz),Y(v)):g.moveTo(X(0),Y(v))});g.stroke();
 g.fillStyle=col('--mute');g.fillText('mg',p.l+4,p.t+12)}
function post(u){fetch(u,{method:'POST'}).then(poll)}
$('recal').onclick=()=>post('/api/recalibrate');$('sev').oninput=e=>$('sevv').textContent=(+e.target.value).toFixed(2);
async function poll(){try{const [s,sp]=await Promise.all([fetch('/api/status').then(r=>r.json()),fetch('/api/spectrum').then(r=>r.json())]);
 last=s;spec=sp;render(s);drawSpec();$('conn').innerHTML='<i style="background:'+col('--ok')+'"></i>live';}
 catch(e){$('conn').innerHTML='<i style="background:'+col('--bad')+'"></i>offline'}}
setInterval(poll,1000);poll();addEventListener('resize',drawSpec);
</script></body></html>)VGHTML";
// ===== vg_diagnosis.h =====
// VibeGuard diagnosis engine: baseline learning, 1x tracking, band energies, fault decision,
// health % and repair advice. Pure C++ so the host test harness runs exactly this code.
#include <math.h>
#include <stdio.h>
#include <string.h>
// ===== vg_dsp.h =====
// Hann window + 256-point radix-2 FFT, written out so it runs the same on the ESP32 and the host.
#include <math.h>
#include <stdint.h>

namespace vg {

class Fft {
 public:
  Fft() {
    for (int i = 0; i < N_FFT; i++) hann_[i] = 0.5f - 0.5f * cosf(2.0f * kPi * i / N_FFT);  // periodic Hann
    for (int i = 0; i < N_FFT / 2; i++) {
      cos_[i] = cosf(2.0f * kPi * i / N_FFT);
      sin_[i] = sinf(2.0f * kPi * i / N_FFT);
    }
    int bits = 0;
    while ((1 << bits) < N_FFT) bits++;
    for (int i = 0; i < N_FFT; i++) {
      int r = 0;
      for (int b = 0; b < bits; b++) r |= ((i >> b) & 1) << (bits - 1 - b);
      rev_[i] = (uint16_t)r;
    }
  }

  // Sum of the window; a sine of amplitude A gives |X| = A * WINDOW_SUM / 2 at its bin.
  static constexpr float WINDOW_SUM = N_FFT / 2.0f;

  // x: N_FFT samples with DC removed. power: N_BINS values of |X[k]|^2.
  void powerSpectrum(const float* x, float* power) {
    for (int i = 0; i < N_FFT; i++) {
      re_[rev_[i]] = x[i] * hann_[i];
      im_[rev_[i]] = 0.0f;
    }
    for (int size = 2; size <= N_FFT; size <<= 1) {
      int half = size >> 1, step = N_FFT / size;
      for (int i = 0; i < N_FFT; i += size) {
        for (int j = 0; j < half; j++) {
          float wr = cos_[j * step], wi = -sin_[j * step];
          int a = i + j, b = a + half;
          float tr = wr * re_[b] - wi * im_[b];
          float ti = wr * im_[b] + wi * re_[b];
          re_[b] = re_[a] - tr;
          im_[b] = im_[a] - ti;
          re_[a] += tr;
          im_[a] += ti;
        }
      }
    }
    for (int k = 0; k < N_BINS; k++) power[k] = re_[k] * re_[k] + im_[k] * im_[k];
  }

 private:
  float hann_[N_FFT], cos_[N_FFT / 2], sin_[N_FFT / 2], re_[N_FFT], im_[N_FFT];
  uint16_t rev_[N_FFT];
};

}  // namespace vg

namespace vg {

enum State : uint8_t { ST_CALIBRATING, ST_HEALTHY, ST_WARNING, ST_ALARM, ST_MOTOR_OFF };
enum Fault : uint8_t { F_NONE, F_IMBALANCE, F_LOOSENESS, F_BEARING };
enum Band : uint8_t { B_IMB, B_LOOSE, B_BEAR, B_COUNT };

inline const char* stateName(State s) {
  static const char* names[] = {"CALIBRATING", "HEALTHY", "WARNING", "ALARM", "MOTOR_OFF"};
  return names[s];
}
inline const char* faultName(Fault f) {
  static const char* names[] = {"NONE", "IMBALANCE", "LOOSENESS", "BEARING"};
  return names[f];
}
inline const char* bandName(int b) {
  static const char* names[] = {"1x shaft", "2x-3x harmonics", "100-240 Hz broadband"};
  return names[b];
}

struct Advice {
  const char* action;
  int repairInr;
  int failureInr;
};

inline Advice adviceFor(Fault f) {
  switch (f) {
    case F_IMBALANCE: return {"Rotor imbalance: clean the fan/rotor, check for a bent shaft or loose blade, re-balance.", COST_REBALANCE, COST_MOTOR_REPLACEMENT};
    case F_LOOSENESS: return {"Mechanical looseness: tighten the mounting bolts and the clamp, check the base for cracks.", COST_TIGHTEN, COST_MOTOR_REPLACEMENT};
    case F_BEARING:   return {"Bearing wear: replace the bearing now, before it seizes and burns the winding.", COST_BEARING_FIX, COST_MOTOR_REPLACEMENT};
    default:          return {"No action needed. Keep monitoring.", 0, 0};
  }
}

inline float clampf(float v, float lo, float hi) { return v < lo ? lo : (v > hi ? hi : v); }

struct Status {
  State state = ST_CALIBRATING;
  Fault fault = F_NONE;
  float health = 100.0f;           // %
  float f1Hz = 0.0f;               // shaft frequency used for this frame
  float baseF1Hz = 0.0f;           // shaft frequency learned during calibration
  bool shaftFound = false;         // a clear 1x peak was found during calibration
  float rmsG = 0.0f;               // time-domain RMS of the frame (DC removed)
  float energy[B_COUNT] = {0, 0, 0};
  float baseline[B_COUNT] = {0, 0, 0};
  float ratio[B_COUNT] = {1, 1, 1};     // EMA-smoothed energy / baseline
  float warnThr[B_COUNT] = {WARN_RATIO, WARN_RATIO, WARN_RATIO};
  float alarmThr[B_COUNT] = {ALARM_RATIO, ALARM_RATIO, ALARM_RATIO};
  int calibDone = 0;
  int calibTotal = CALIB_FRAMES;
  int calibRejected = 0;           // frames skipped because the motor looked stopped
  uint32_t frames = 0;
};

class Engine {
 public:
  void startCalibration() {
    st_ = Status();
    for (int b = 0; b < B_COUNT; b++) persist_[b] = 0;
  }

  // Feed one frame of N_FFT Z-axis samples in g (gravity included is fine; the mean is removed).
  void processFrame(const float* samplesG) {
    float mean = 0;
    for (int i = 0; i < N_FFT; i++) mean += samplesG[i];
    mean /= N_FFT;
    float ss = 0;
    for (int i = 0; i < N_FFT; i++) {
      x_[i] = samplesG[i] - mean;
      ss += x_[i] * x_[i];
    }
    st_.rmsG = sqrtf(ss / N_FFT);
    st_.frames++;
    fft_.powerSpectrum(x_, power_);
    for (int k = 0; k < N_BINS; k++) ampMg_[k] = 2.0f * sqrtf(power_[k]) / Fft::WINDOW_SUM * 1000.0f;

    bool motorOff = st_.rmsG < MOTOR_OFF_RMS_G;
    if (st_.state == ST_CALIBRATING) {
      if (motorOff) { st_.calibRejected++; return; }
      memcpy(calib_[st_.calibDone++], power_, sizeof(power_));
      if (st_.calibDone >= CALIB_FRAMES) finishCalibration();
      return;
    }
    if (motorOff) {
      st_.state = ST_MOTOR_OFF;
      st_.fault = F_NONE;
      for (int b = 0; b < B_COUNT; b++) persist_[b] = 0;
      return;
    }

    // Re-track 1x near the learned speed so small speed changes do not look like faults.
    float tol = fmaxf(st_.baseF1Hz * SHAFT_TRACK_TOL, 2.0f * BIN_HZ);
    bool found = false;
    float f1 = findPeakHz(power_, st_.baseF1Hz - tol, st_.baseF1Hz + tol, &found);
    st_.f1Hz = found ? f1 : st_.baseF1Hz;

    bandEnergies(power_, st_.f1Hz, st_.energy);
    for (int b = 0; b < B_COUNT; b++) {
      float r = (st_.energy[b] + ENERGY_FLOOR) / (st_.baseline[b] + ENERGY_FLOOR);
      st_.ratio[b] += EMA_ALPHA * (r - st_.ratio[b]);
      // Hysteresis: once declared, a band stays active until it falls clearly below the threshold.
      float onThr = persist_[b] >= PERSIST_FRAMES ? st_.warnThr[b] * CLEAR_HYSTERESIS : st_.warnThr[b];
      persist_[b] = st_.ratio[b] >= onThr ? persist_[b] + 1 : 0;
    }
    decide();
  }

  const Status& status() const { return st_; }
  const float* amplitudeMg() const { return ampMg_; }  // N_BINS values, last frame

  // Peak search between loHz and hiHz with parabolic interpolation on log power.
  static float findPeakHz(const float* p, float loHz, float hiHz, bool* found) {
    int lo = (int)ceilf(loHz / BIN_HZ), hi = (int)floorf(hiHz / BIN_HZ);
    if (lo < 1) lo = 1;
    if (hi > N_BINS - 2) hi = N_BINS - 2;
    if (hi < lo) { *found = false; return 0; }
    int best = lo;
    float sum = 0;
    for (int k = lo; k <= hi; k++) {
      sum += p[k];
      if (p[k] > p[best]) best = k;
    }
    float meanP = sum / (hi - lo + 1);
    *found = p[best] > PEAK_PROMINENCE * meanP;
    float a = logf(p[best - 1] + 1e-20f), b = logf(p[best] + 1e-20f), c = logf(p[best + 1] + 1e-20f);
    float den = a - 2.0f * b + c;
    float delta = den != 0.0f ? clampf(0.5f * (a - c) / den, -0.5f, 0.5f) : 0.0f;
    return (best + delta) * BIN_HZ;
  }

  static float harmonicEnergy(const float* p, float fHz) {
    int c = (int)lroundf(fHz / BIN_HZ);
    if (c < 1 || c > N_BINS - 1) return 0.0f;
    float e = 0;
    for (int k = c - HARMONIC_HALF_WIDTH; k <= c + HARMONIC_HALF_WIDTH; k++)
      if (k >= 1 && k < N_BINS) e += p[k];
    return e;
  }

  static void bandEnergies(const float* p, float f1, float* e) {
    e[B_IMB] = harmonicEnergy(p, f1);
    e[B_LOOSE] = harmonicEnergy(p, 2.0f * f1) + harmonicEnergy(p, 3.0f * f1);
    int lo = (int)ceilf(BEARING_LO_HZ / BIN_HZ), hi = (int)floorf(BEARING_HI_HZ / BIN_HZ);
    float sum = 0;
    for (int k = lo; k <= hi && k < N_BINS; k++) {
      bool onHarmonic = false;
      for (int m = 1; m <= BEARING_EXCLUDE_HARMONICS && !onHarmonic; m++)
        onHarmonic = fabsf(k - m * f1 / BIN_HZ) <= BEARING_EXCLUDE_HALF_WIDTH + 0.5f;
      if (!onHarmonic) sum += p[k];
    }
    e[B_BEAR] = sum;
  }

 private:
  void finishCalibration() {
    static float avg[N_BINS];
    for (int k = 0; k < N_BINS; k++) {
      float s = 0;
      for (int f = 0; f < CALIB_FRAMES; f++) s += calib_[f][k];
      avg[k] = s / CALIB_FRAMES;
    }
    st_.baseF1Hz = findPeakHz(avg, SHAFT_MIN_HZ, SHAFT_MAX_HZ, &st_.shaftFound);
    st_.f1Hz = st_.baseF1Hz;

    // Per-band mean and spread over the calibration frames set the thresholds for this motor.
    float sum[B_COUNT] = {0, 0, 0}, sum2[B_COUNT] = {0, 0, 0}, e[B_COUNT];
    for (int f = 0; f < CALIB_FRAMES; f++) {
      bandEnergies(calib_[f], st_.baseF1Hz, e);
      for (int b = 0; b < B_COUNT; b++) { sum[b] += e[b]; sum2[b] += e[b] * e[b]; }
    }
    for (int b = 0; b < B_COUNT; b++) {
      float mean = sum[b] / CALIB_FRAMES;
      float var = fmaxf(sum2[b] / CALIB_FRAMES - mean * mean, 0.0f);
      float cv = sqrtf(var) / (mean + ENERGY_FLOOR);
      st_.baseline[b] = mean;
      st_.warnThr[b] = fmaxf(WARN_RATIO, 1.0f + THRESH_K_SIGMA * cv);
      st_.alarmThr[b] = fmaxf(ALARM_RATIO, st_.warnThr[b] * ALARM_RATIO / WARN_RATIO);
      st_.ratio[b] = 1.0f;
      st_.energy[b] = mean;
    }
    st_.state = ST_HEALTHY;
  }

  void decide() {
    int worst = -1;
    float worstScore = 0, maxRatio = 1.0f;
    for (int b = 0; b < B_COUNT; b++) {
      maxRatio = fmaxf(maxRatio, st_.ratio[b]);
      float score = st_.ratio[b] / st_.warnThr[b];
      if (persist_[b] >= PERSIST_FRAMES && score > worstScore) { worstScore = score; worst = b; }
    }
    st_.health = 100.0f * clampf(1.0f - logf(maxRatio) / logf(HEALTH_ZERO_RATIO), 0.0f, 1.0f);
    if (worst < 0) {
      st_.state = ST_HEALTHY;
      st_.fault = F_NONE;
      return;
    }
    Fault f = (Fault)(worst + 1);
    bool wasAlarm = st_.state == ST_ALARM && st_.fault == f;
    float alarmOn = wasAlarm ? st_.alarmThr[worst] * ALARM_HYSTERESIS : st_.alarmThr[worst];
    st_.fault = f;
    st_.state = st_.ratio[worst] >= alarmOn ? ST_ALARM : ST_WARNING;
  }

  Fft fft_;
  Status st_;
  int persist_[B_COUNT] = {0, 0, 0};
  float x_[N_FFT];
  float power_[N_BINS];
  float ampMg_[N_BINS];
  float calib_[CALIB_FRAMES][N_BINS];
};

// ---- JSON for the dashboard (also used by the host mock server) -----------------------------

struct RuntimeInfo {
  uint32_t uptimeMs = 0;
  uint32_t procMicros = 0;     // time spent in processFrame
  uint32_t maxJitterUs = 0;    // worst deviation from the 2000 us sample period
  uint32_t overruns = 0;       // frames dropped because processing was late
  uint32_t i2cErrors = 0;
  bool sim = false;
  const char* scenario = "";
  float severity = 0;
};

inline int statusJson(const Engine& eng, const RuntimeInfo& rt, char* out, size_t n) {
  const Status& s = eng.status();
  Advice a = adviceFor(s.fault);
  return snprintf(out, n,
      "{\"state\":\"%s\",\"fault\":\"%s\",\"health\":%.1f,\"f1\":%.2f,\"baseF1\":%.2f,\"rpm\":%d,"
      "\"shaftFound\":%s,\"rmsMg\":%.2f,"
      "\"ratio\":[%.3f,%.3f,%.3f],\"warn\":[%.2f,%.2f,%.2f],\"alarm\":[%.2f,%.2f,%.2f],"
      "\"energy\":[%.4g,%.4g,%.4g],\"baseline\":[%.4g,%.4g,%.4g],"
      "\"calib\":{\"done\":%d,\"total\":%d,\"rejected\":%d},\"frames\":%lu,"
      "\"advice\":{\"action\":\"%s\",\"repair\":%d,\"failure\":%d,\"saving\":%d},"
      "\"rt\":{\"uptimeMs\":%lu,\"procUs\":%lu,\"jitterUs\":%lu,\"overruns\":%lu,\"i2cErrors\":%lu},"
      "\"sim\":%s,\"scenario\":\"%s\",\"severity\":%.2f}",
      stateName(s.state), faultName(s.fault), s.health, s.f1Hz, s.baseF1Hz, (int)lroundf(s.f1Hz * 60.0f),
      s.shaftFound ? "true" : "false", s.rmsG * 1000.0f,
      s.ratio[0], s.ratio[1], s.ratio[2], s.warnThr[0], s.warnThr[1], s.warnThr[2],
      s.alarmThr[0], s.alarmThr[1], s.alarmThr[2],
      s.energy[0], s.energy[1], s.energy[2], s.baseline[0], s.baseline[1], s.baseline[2],
      s.calibDone, s.calibTotal, s.calibRejected, (unsigned long)s.frames,
      a.action, a.repairInr, a.failureInr, a.failureInr - a.repairInr,
      (unsigned long)rt.uptimeMs, (unsigned long)rt.procMicros, (unsigned long)rt.maxJitterUs,
      (unsigned long)rt.overruns, (unsigned long)rt.i2cErrors,
      rt.sim ? "true" : "false", rt.scenario, rt.severity);
}

inline int spectrumJson(const Engine& eng, char* out, size_t n) {
  int len = snprintf(out, n, "{\"binHz\":%.4f,\"f1\":%.2f,\"bearing\":[%.0f,%.0f],\"mg\":[",
                     BIN_HZ, eng.status().f1Hz, BEARING_LO_HZ, BEARING_HI_HZ);
  const float* a = eng.amplitudeMg();
  for (int k = 0; k < N_BINS && len < (int)n; k++)
    len += snprintf(out + len, n - len, k ? ",%.2f" : "%.2f", a[k]);
  if (len < (int)n) len += snprintf(out + len, n - len, "]}");
  return len;
}

}  // namespace vg
// ===== vg_sim.h =====
// Synthetic motor vibration for the Wokwi simulation and the host tests.
// Wokwi's MPU6050 only holds a static value set by sliders, so in a VG_SIM build this signal is
// added on top of the real sensor reading. All amplitudes are in g (Z axis, gravity excluded).
#include <math.h>
#include <stdint.h>

namespace vg {

enum Scenario : uint8_t { SC_HEALTHY, SC_IMBALANCE, SC_LOOSENESS, SC_BEARING, SC_MOTOR_OFF, SC_COUNT };

inline const char* scenarioName(Scenario s) {
  static const char* names[] = {"healthy", "imbalance", "looseness", "bearing", "motor_off"};
  return names[s];
}

// Healthy signature of the reference motor (about the size of a small DC/fan motor at 1500 RPM).
struct MotorProfile {
  float shaftHz = 25.0f;
  float a1 = 0.040f;          // 1x amplitude
  float a2 = 0.008f;          // 2x
  float a3 = 0.004f;          // 3x
  float noise = 0.004f;       // white noise sigma, close to the MPU6050's ~4 mg rms at 260 Hz bandwidth
  float bearingBg = 0.002f;   // background structural resonance
};

class SimSource {
 public:
  explicit SimSource(uint32_t seed = 12345) : rng_(seed ? seed : 1) {
    for (int i = 0; i < kRes; i++) resPh_[i] = 2.0f * kPi * uniform();
  }

  void set(Scenario sc, float severity) { scenario = sc; this->severity = severity; }

  // Next sample in g. severity 0 = healthy amplitudes, 1 = a clear, typical fault.
  float next() {
    float s = severity, f = profile.shaftHz;
    // Phase accumulators (wrapped at 2*pi) keep long runs exact; w is the 1x phase.
    float w = advance(shaftPh_, f);
    float halfW = advance(halfPh_, 0.5f * f);
    float bpfoPh = advance(bpfoPh_, 3.05f * f);
    for (int i = 0; i < kRes; i++) advance(resPh_[i], 150.0f + 15.0f * i);
    float v = profile.noise * gauss();
    if (scenario == SC_MOTOR_OFF) return v;

    float a1 = profile.a1, a2 = profile.a2, a3 = profile.a3, res = profile.bearingBg;
    float sub = 0, high = 0;
    if (scenario == SC_IMBALANCE) a1 *= 1.0f + 2.0f * s;
    if (scenario == SC_LOOSENESS) {
      a1 *= 1.0f + 0.2f * s;
      a2 *= 1.0f + 4.0f * s;
      a3 *= 1.0f + 6.0f * s;
      sub = 0.006f * s;       // 0.5x sub-harmonic
      high = 0.003f * s;      // 4x..6x harmonics
    }
    if (scenario == SC_BEARING) res *= 1.0f + 8.0f * s;

    v += a1 * sinf(w) + a2 * sinf(2 * w + 0.7f) + a3 * sinf(3 * w + 1.9f);
    if (sub > 0) v += sub * sinf(halfW + 0.3f);
    if (high > 0) v += high * (sinf(4 * w + 0.4f) + sinf(5 * w + 2.2f) + sinf(6 * w + 1.1f));

    // Bearing defect: a 150-210 Hz resonance, amplitude-modulated at the outer-race pass frequency.
    float m = 0.5f * (1.0f + cosf(bpfoPh));
    float r = 0;
    for (int i = 0; i < kRes; i++) r += sinf(resPh_[i]);
    v += res * m * r / sqrtf((float)kRes);
    return v;
  }

  MotorProfile profile;
  Scenario scenario = SC_HEALTHY;
  float severity = 1.0f;

 private:
  static constexpr int kRes = 5;
  // Returns the phase for this sample, then steps it by one sample period.
  static float advance(float& ph, float hz) {
    float now = ph;
    ph += 2.0f * kPi * hz / FS_HZ;
    if (ph >= 2.0f * kPi) ph -= 2.0f * kPi;
    return now;
  }
  float uniform() {
    rng_ ^= rng_ << 13;
    rng_ ^= rng_ >> 17;
    rng_ ^= rng_ << 5;
    return (rng_ >> 8) * (1.0f / 16777216.0f);
  }
  float gauss() {
    float u1 = uniform(), u2 = uniform();
    if (u1 < 1e-7f) u1 = 1e-7f;
    return sqrtf(-2.0f * logf(u1)) * cosf(2.0f * kPi * u2);
  }
  uint32_t rng_;
  float shaftPh_ = 0, halfPh_ = 0, bpfoPh_ = 0, resPh_[kRes];
};

}  // namespace vg

// ---- Pins (ESP32 DevKit V1 / DevKitC) ----
constexpr int PIN_SDA = 21;
constexpr int PIN_SCL = 22;
constexpr int PIN_LED = 25;   // amber status LED through 220 ohm
constexpr int PIN_BTN = 27;   // push button to GND (internal pull-up)

// ---- MPU6050 registers ----
constexpr uint8_t MPU_ADDR = 0x68;
constexpr uint8_t REG_SMPLRT_DIV = 0x19, REG_CONFIG = 0x1A, REG_ACCEL_CONFIG = 0x1C;
constexpr uint8_t REG_ACCEL_ZOUT_H = 0x3F, REG_PWR_MGMT_1 = 0x6B, REG_WHO_AM_I = 0x75;

constexpr char AP_SSID[] = "VibeGuard";
constexpr char AP_PASS[] = "vibeguard";   // WPA2 needs at least 8 characters
constexpr uint32_t SAMPLE_PERIOD_US = (uint32_t)(1000000.0f / vg::FS_HZ);  // 2000 us

static vg::Engine engine;
static vg::RuntimeInfo runtime;
static WebServer server(80);
static SemaphoreHandle_t engineLock;
static TaskHandle_t samplerTask, dspTask;

// Double buffer: the sampler fills one half while the DSP task processes the other.
static int16_t frameBuf[2][vg::N_FFT];
static volatile int readyBuf = -1;

#if VG_SIM
static vg::SimSource sim;
#endif

// ---------------------------------------------------------------------------------------------
static bool mpuWrite(uint8_t reg, uint8_t val) {
  Wire.beginTransmission(MPU_ADDR);
  Wire.write(reg);
  Wire.write(val);
  return Wire.endTransmission() == 0;
}

static bool mpuRead(uint8_t reg, uint8_t* out, uint8_t n) {
  Wire.beginTransmission(MPU_ADDR);
  Wire.write(reg);
  if (Wire.endTransmission(false) != 0) return false;
  if (Wire.requestFrom(MPU_ADDR, n) != n) return false;
  for (uint8_t i = 0; i < n; i++) out[i] = Wire.read();
  return true;
}

static bool mpuBegin() {
  uint8_t who = 0;
  if (!mpuRead(REG_WHO_AM_I, &who, 1) || who != 0x68) {
    Serial.printf("MPU6050 not found (WHO_AM_I=0x%02X). Check SDA=%d SCL=%d.\n", who, PIN_SDA, PIN_SCL);
    return false;
  }
  return mpuWrite(REG_PWR_MGMT_1, 0x01) &&     // wake, PLL on gyro X clock
         mpuWrite(REG_CONFIG, 0x00) &&         // DLPF 260 Hz accel bandwidth (keeps the 100-240 Hz band)
         mpuWrite(REG_SMPLRT_DIV, 0x00) &&     // accel registers update at 1 kHz; we read at 500 Hz
         mpuWrite(REG_ACCEL_CONFIG, 0x08);     // +-4 g -> 8192 LSB/g
}

// ---------------------------------------------------------------------------------------------
// Sampling: esp_timer ticks every 2 ms and wakes a high-priority task that reads the sensor.
static void IRAM_ATTR onSampleTimer(void*) { xTaskNotifyGive(samplerTask); }

static void samplerLoop(void*) {
  int buf = 0, pos = 0;
  int64_t lastUs = 0;
  for (;;) {
    ulTaskNotifyTake(pdTRUE, portMAX_DELAY);
    int64_t now = esp_timer_get_time();
    if (lastUs) {
      int64_t dev = (now - lastUs) - (int64_t)SAMPLE_PERIOD_US;
      uint32_t adev = (uint32_t)(dev < 0 ? -dev : dev);
      if (adev > runtime.maxJitterUs) runtime.maxJitterUs = adev;
    }
    lastUs = now;

    uint8_t b[2];
    int16_t z = 0;
    if (mpuRead(REG_ACCEL_ZOUT_H, b, 2)) z = (int16_t)((b[0] << 8) | b[1]);
    else runtime.i2cErrors++;
#if VG_SIM
    int32_t v = z + (int32_t)lroundf(sim.next() * vg::LSB_PER_G);
    z = (int16_t)(v > 32767 ? 32767 : (v < -32768 ? -32768 : v));
#endif
    frameBuf[buf][pos++] = z;
    if (pos == vg::N_FFT) {
      if (readyBuf != -1) runtime.overruns++;  // DSP did not finish the previous frame in time
      readyBuf = buf;
      buf ^= 1;
      pos = 0;
      xTaskNotifyGive(dspTask);
    }
  }
}

static void dspLoop(void*) {
  static float g[vg::N_FFT];
  uint32_t logCount = 0;
  for (;;) {
    ulTaskNotifyTake(pdTRUE, portMAX_DELAY);
    int idx = readyBuf;
    if (idx < 0) continue;
    for (int i = 0; i < vg::N_FFT; i++) g[i] = frameBuf[idx][i] / vg::LSB_PER_G;
    readyBuf = -1;

    xSemaphoreTake(engineLock, portMAX_DELAY);
    int64_t t0 = esp_timer_get_time();
    engine.processFrame(g);
    runtime.procMicros = (uint32_t)(esp_timer_get_time() - t0);
    const vg::Status s = engine.status();
    xSemaphoreGive(engineLock);

    if (++logCount % 2 == 0) {  // about once a second
      Serial.printf("[%7.1fs] %-11s %-9s health=%5.1f%% f1=%5.2fHz rpm=%4d rms=%5.1fmg R=%.2f/%.2f/%.2f dsp=%luus",
                    millis() / 1000.0f, vg::stateName(s.state), vg::faultName(s.fault), s.health, s.f1Hz,
                    (int)lroundf(s.f1Hz * 60), s.rmsG * 1000, s.ratio[0], s.ratio[1], s.ratio[2],
                    (unsigned long)runtime.procMicros);
      if (s.state == vg::ST_CALIBRATING) Serial.printf(" calib=%d/%d", s.calibDone, s.calibTotal);
#if VG_SIM
      Serial.printf(" sim=%s@%.2f", vg::scenarioName(sim.scenario), sim.severity);
#endif
      Serial.println();
    }
  }
}

// ---------------------------------------------------------------------------------------------
static void recalibrate() {
  xSemaphoreTake(engineLock, portMAX_DELAY);
  engine.startCalibration();
  xSemaphoreGive(engineLock);
  Serial.println("Re-learning baseline: keep the motor running in its healthy state for 20 s.");
}

#if VG_SIM
static void setScenario(vg::Scenario sc, float severity) {
  sim.set(sc, severity);
  Serial.printf("SIM scenario -> %s (severity %.2f)\n", vg::scenarioName(sc), severity);
}
#endif

static void sendJson(int (*fill)(char*, size_t)) {
  static char buf[2600];
  xSemaphoreTake(engineLock, portMAX_DELAY);
  fill(buf, sizeof buf);
  xSemaphoreGive(engineLock);
  server.sendHeader("Cache-Control", "no-store");
  server.send(200, "application/json", buf);
}

static int fillStatus(char* out, size_t n) {
  runtime.uptimeMs = millis();
#if VG_SIM
  runtime.sim = true;
  runtime.scenario = vg::scenarioName(sim.scenario);
  runtime.severity = sim.severity;
#endif
  return vg::statusJson(engine, runtime, out, n);
}
static int fillSpectrum(char* out, size_t n) { return vg::spectrumJson(engine, out, n); }

static void setupWeb() {
  server.on("/", HTTP_GET, [] { server.send_P(200, "text/html", DASHBOARD_HTML); });
  server.on("/api/status", HTTP_GET, [] { sendJson(fillStatus); });
  server.on("/api/spectrum", HTTP_GET, [] { sendJson(fillSpectrum); });
  server.on("/api/recalibrate", HTTP_POST, [] { recalibrate(); server.send(200, "application/json", "{\"ok\":true}"); });
#if VG_SIM
  server.on("/api/sim", HTTP_POST, [] {
    String name = server.arg("scenario");
    float sev = server.hasArg("severity") ? server.arg("severity").toFloat() : sim.severity;
    for (int i = 0; i < vg::SC_COUNT; i++)
      if (name == vg::scenarioName((vg::Scenario)i)) setScenario((vg::Scenario)i, sev);
    server.send(200, "application/json", "{\"ok\":true}");
  });
#endif
  server.onNotFound([] { server.send(404, "text/plain", "not found"); });
  server.begin();
}

static void setupWifi() {
#if VG_SIM
  WiFi.mode(WIFI_STA);
  WiFi.begin("Wokwi-GUEST", "", 6);  // Wokwi has no soft-AP; its gateway forwards port 80 instead
  Serial.println("WiFi: joining Wokwi-GUEST (simulation build)");
#else
  WiFi.mode(WIFI_AP);
  WiFi.softAP(AP_SSID, AP_PASS);
  Serial.printf("WiFi AP \"%s\" (password \"%s\"), dashboard at http://%s/\n", AP_SSID, AP_PASS,
                WiFi.softAPIP().toString().c_str());
#endif
}

// ---------------------------------------------------------------------------------------------
// Status LED: calibrating = 2 Hz blink, healthy = short blip every 3 s, warning = 1 Hz, alarm = 5 Hz,
// motor off = off.
static void updateLed() {
  uint32_t t = millis();
  bool on = false;
  switch (engine.status().state) {
    case vg::ST_CALIBRATING: on = (t / 250) % 2; break;
    case vg::ST_HEALTHY:     on = (t % 3000) < 80; break;
    case vg::ST_WARNING:     on = (t / 500) % 2; break;
    case vg::ST_ALARM:       on = (t / 100) % 2; break;
    default:                 on = false; break;
  }
  digitalWrite(PIN_LED, on);
}

// Button: hold 1.5 s = re-learn baseline. In the simulation build a short press cycles the scenario.
static void updateButton() {
  static bool wasDown = false;
  static uint32_t downAt = 0;
  static bool longDone = false;
  bool down = digitalRead(PIN_BTN) == LOW;
  uint32_t t = millis();
  if (down && !wasDown) { downAt = t; longDone = false; }
  if (down && !longDone && t - downAt > 1500) { longDone = true; recalibrate(); }
  if (!down && wasDown && !longDone && t - downAt > 30) {
#if VG_SIM
    setScenario((vg::Scenario)((sim.scenario + 1) % vg::SC_COUNT), sim.severity);
#endif
  }
  wasDown = down;
}

// Serial commands: r = re-learn, j = print status JSON; simulation build adds
// h/i/l/b/o = healthy/imbalance/looseness/bearing/motor off, 0-9 = severity 0.0-1.8.
static void updateSerial() {
  while (Serial.available()) {
    char c = Serial.read();
    if (c == 'r') recalibrate();
    if (c == 'j') { static char buf[2600]; xSemaphoreTake(engineLock, portMAX_DELAY); fillStatus(buf, sizeof buf); xSemaphoreGive(engineLock); Serial.println(buf); }
#if VG_SIM
    const char* keys = "hilbo";
    for (int i = 0; i < vg::SC_COUNT; i++) if (c == keys[i]) setScenario((vg::Scenario)i, sim.severity);
    if (c >= '0' && c <= '9') setScenario(sim.scenario, (c - '0') * 0.2f);
#endif
  }
}

// ---------------------------------------------------------------------------------------------
void setup() {
  Serial.begin(115200);
  delay(200);
  Serial.println("\nVibeGuard starting");
  pinMode(PIN_LED, OUTPUT);
  pinMode(PIN_BTN, INPUT_PULLUP);
  Wire.begin(PIN_SDA, PIN_SCL);
  Wire.setClock(400000);
  if (!mpuBegin()) {
    for (;;) { digitalWrite(PIN_LED, (millis() / 100) % 2); delay(10); }  // fast blink forever = sensor fault
  }
  Serial.println("MPU6050 ready: +-4 g, DLPF 260 Hz, sampling Z at 500 Hz");

  engineLock = xSemaphoreCreateMutex();
  engine.startCalibration();
#if VG_SIM
  setScenario(vg::SC_HEALTHY, 1.0f);
#endif
  setupWifi();
  setupWeb();

  xTaskCreatePinnedToCore(dspLoop, "vg_dsp", 6144, nullptr, 3, &dspTask, 0);
  xTaskCreatePinnedToCore(samplerLoop, "vg_sample", 4096, nullptr, 10, &samplerTask, 1);
  const esp_timer_create_args_t args = {.callback = onSampleTimer, .arg = nullptr, .dispatch_method = ESP_TIMER_TASK,
                                        .name = "vg_tick", .skip_unhandled_events = true};
  esp_timer_handle_t timer;
  esp_timer_create(&args, &timer);
  esp_timer_start_periodic(timer, SAMPLE_PERIOD_US);
  Serial.println("Learning the healthy baseline for 20 s...");
}

void loop() {
  server.handleClient();
  updateLed();
  updateButton();
  updateSerial();
  delay(2);
}
